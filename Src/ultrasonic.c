#include "stm32f0xx.h"
#include "ultrasonic.h"

volatile int period, duty = 0; // Период и длительность импульса

// Функция инициализации таймера 6

void TIM6_init(void)
{
	RCC->APB1ENR |= (1 << 4); 				// Тактирование таймера 6
	
	TIM6->PSC = 24 - 1; 							// Значение предделителя
	TIM6->ARR = 0xffff - 1;						// Значение автоперезагрузки
	TIM6->CR1 |= (1 << 0);						// Включение счетчика таймера
	while (!(TIM6->SR & (1 << 0))); 	// Проверка установки флага
}

//------------------------------------------------------------------------------------------------------------

// Функция задержки в мс

void Delay_ms(uint16_t ms)
{
	for(uint16_t i = 0; i < ms;i++)
	{
		Delay_us(1000);
	}
}

// Функция задержки в мкс

void Delay_us(uint16_t us)
{
	TIM6->CNT = 0;
	while(TIM6->CNT < us);
}

//-----------------------------Настройка работы таймера общего назначения---------------------------------------

//-----------------------------------------Режим захвата-------------------------------------------------

// Функция инициализации таймера 3

void TIM3_init(void)
{
	RCC->APB1ENR |= (1 << 1); 				// Тактирование таймера 3

	TIM3->PSC = 24 - 1; 							// Значение предделителя
	TIM3->ARR = 0xffff - 1;						// Значение автоперезагрузки
	
	// Настройки режима захвата периода

	TIM3->CCMR1 |= TIM_CCMR1_CC1S_0;							// Вход для сигнала захвата TI1 для 1 канала
	TIM3->CCMR1 &= ~TIM_CCMR1_IC1F; 							// Значение фильтрации (частота выборок) - 0
	TIM3->CCER &= ~TIM_CCER_CC1P; 								// Захват по возрастающему фронту канала 1
	TIM3->CCMR1 &= ~TIM_CCMR1_IC1PSC; 						// Значение предделителя для захвата - 0
	TIM3->SMCR |= TIM_SMCR_TS_0 | TIM_SMCR_TS_2;  // Установка входа триггера 1 (TI1FP1)
	TIM3->SMCR |= TIM_SMCR_SMS_2; 								// Установка режима сброса	
	TIM3->CCER |= TIM_CCER_CC1E;									// Включение режима захвата для 1 канала
	
	// Настройки режима захвата длительности
	
	TIM3->CCMR1 |= TIM_CCMR1_CC2S_1;							// Вход для сигнала захвата TI1 для 2 канала
	TIM3->CCER |= TIM_CCER_CC2P; 									// Захват по спадающему фронту канала 2
	TIM3->CCER |= TIM_CCER_CC2E;									// Включение режима захвата для 2 канала
	
	TIM3->DIER |= TIM_DIER_CC1IE;     						// Включение запроса на прерывание по захвату
	TIM3->CR1 |= (1 << 0);												// Включение счетчика таймера
	NVIC_EnableIRQ(TIM3_IRQn);										// Включение прерываний по таймеру 3
}

void TIM3_IRQHandler() 
{
	// Проверка флагов захвата и перезахвата
		if ((TIM3->SR & TIM_SR_CC1IF) != 0) 
		{
				TIM3->SR &= ~TIM_SR_CC1IF; 			// Сброс флага захвата
			
				if ((TIM3->SR & TIM_SR_CC1OF) != 0) 
				{
						TIM3->SR &= ~TIM_SR_CC1OF; 	// Сброс флага перезахвата
				}
				
				period = TIM3->CCR1; 	// Чтение данных периода сигнала
				duty = TIM3->CCR2;		// Чтение данных длительности сигнала
		}
}
